## meta-incredible-machine/conf/bblayers.conf.sample
```bitbake
POKY_BBLAYERS_CONF_VERSION = "1"

BBPATH = "${TOPDIR}"
BBFILES ?= ""

BBLAYERS ?= " \
    ##OEROOT##/../meta-incredible-machine \
    ##OEROOT##/../meta-openembedded/meta-oe \
    ##OEROOT##/../meta-raspberrypi \
    ##OEROOT##/meta \
    ##OEROOT##/meta-poky \
    ##OEROOT##/meta-yocto-bsp \
"
```

## meta-incredible-machine/conf/distro/incredible.conf
```bitbake
MAINTAINER = "flederwiesel <flederwiesel@fra-flugplan.de>"

DISTRO = "incredible"
DISTRO_NAME = "incredible"
DISTRO_VERSION[vardepsexclude] = "DATE"
DISTRO_VERSION = "1.0.0"
DISTRO_CODENAME = "Anchorage"

DISTRO_FEATURES = "acl ext2 ipv4 keyboard largefile ldconfig nfs pam pci systemd systemd-resolved usbgadget usbhost vfat xattr zeroconf"
DISTRO_FEATURES_BACKFILL_CONSIDERED = "pulseaudio sysvinit gobject-introspection-data"
DISTRO_FEATURES_NATIVE = "xattr"
DISTRO_FEATURES_NATIVESDK = ""

IMAGE_NAME[vardepsexclude] = "DATETIME"
IMAGE_NAME = "${IMAGE_BASENAME}-${DISTRO_VERSION}-${DISTRO_CODENAME}-${MACHINE}-${DATETIME}"
IMAGE_LINK_NAME = "${IMAGE_BASENAME}-${DISTRO_VERSION}-${DISTRO_CODENAME}-${MACHINE}"
IMAGE_FSTYPES = "tar.bz2 wic.bz2"

SDK_VERSION = "${DISTRO_VERSION}-${DISTRO_CODENAME}"

VIRTUAL-RUNTIME_init_manager = "systemd"
VIRTUAL-RUNTIME_editor = "nano"

SANITY_TESTED_DISTROS = "\
    ubuntu-22.04 \n \
"
```

## meta-incredible-machine/conf/layer.conf
```bitbake
# We have a conf and classes directory, add to BBPATH
BBPATH .= ":${LAYERDIR}"

# We have recipes-* directories, add to BBFILES
BBFILES += "${LAYERDIR}/recipes-*/*/*.bb \
            ${LAYERDIR}/recipes-*/*/*.bbappend"

BBFILE_COLLECTIONS += "meta-incredible-machine"
BBFILE_PATTERN_meta-incredible-machine = "^${LAYERDIR}/"
BBFILE_PRIORITY_meta-incredible-machine = "50"

LAYERVERSION_incredible-machine = "1"
LAYERDEPENDS_meta-incredible-machine = "core openembedded-layer raspberrypi"
LAYERSERIES_COMPAT_meta-incredible-machine = "kirkstone"
```

## meta-incredible-machine/conf/local.conf.sample
```bitbake
MACHINE ?= "raspberrypi"

DISTRO = "incredible"

DEFAULT_TIMEZONE = "Europe/Berlin"

TMPDIR = "${TOPDIR}/tmp"
DL_DIR = "${TOPDIR}/../downloads"
SSTATE_DIR = "${TOPDIR}/../sstate"

SDKMACHINE ?= "x86_64"
SDK_NAME_PREFIX ?= "${DISTRO}-sdk"
SDK_EXT_TYPE ?= "minimal"
SDK_INCLUDE_TOOLCHAIN = "1"

COPY_LIC_MANIFEST = "1"
COPY_LIC_DIRS = "1"

LICENSE_CREATE_PACKAGE = "1"

SANITY_TESTED_DISTROS = "\
    ubuntu-22.04 \n \
"
```
